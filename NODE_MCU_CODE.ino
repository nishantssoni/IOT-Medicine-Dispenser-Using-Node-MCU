#include <WiFiManager.h>
#include <Firebase_ESP_Client.h>
/* for OLED display */
#include <SPI.h>
#include <Wire.h>
#include <Adafruit_GFX.h>
#include <Adafruit_SSD1306.h>

/* ---------------------------------------------------------------------------------------------------- */
/* OLED setup */
#define SCREEN_WIDTH 128  // OLED display width, in pixels
#define SCREEN_HEIGHT 32  // OLED display height, in pixels

#define OLED_RESET -1        // Reset pin # (or -1 if sharing Arduino reset pin)
#define SCREEN_ADDRESS 0x3C  ///< See datasheet for Address; 0x3D for 128x64, 0x3C for 128x32
/* ---------------------------------------------------------------------------------------------------- */


/* ---------------------------------------------------------------------------------------------------- */
/* Firebase defines */
/* 2. Define the API Key */
#define API_KEY "your api key"

/* 3. Define the RTDB URL */
#define DATABASE_URL "https://jhfjghjhgj.firebaseio.com/"

/* 4. Define the user Email and password that alreadey registerd or added in your project */
#define USER_EMAIL "youremail@gmail.com"
#define USER_PASSWORD "123456"
/* ---------------------------------------------------------------------------------------------------- */



/* ---------------------------------------------------------------------------------------------------- */
/* oled initialize and all bitmaps */
Adafruit_SSD1306 display(SCREEN_WIDTH, SCREEN_HEIGHT, &Wire, OLED_RESET);

const unsigned char PROGMEM init_logo[] = {
  0xff, 0xff, 0xff, 0xff, 0xff, 0xff, 0xff, 0x00, 0x00, 0x7f, 0xff, 0xff, 0xff, 0xff, 0xff, 0xff,
  0xff, 0xff, 0xff, 0xff, 0xff, 0x80, 0x00, 0x00, 0x00, 0x00, 0x00, 0xff, 0xff, 0xff, 0xff, 0xff,
  0xff, 0xff, 0xff, 0xff, 0x80, 0x00, 0x00, 0x00, 0x00, 0x00, 0x00, 0x00, 0xff, 0xff, 0xff, 0xff,
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  0xff, 0xff, 0xff, 0xff, 0xff, 0xff, 0xff, 0xe0, 0x00, 0xff, 0xff, 0xff, 0xff, 0xff, 0xff, 0xff
};

static const uint8_t PROGMEM wifi_logo[] = {
  0xff, 0xff, 0xff, 0xff, 0xff, 0xff, 0xff, 0xff, 0xff, 0xff, 0xff, 0xff, 0xff, 0xff, 0xff, 0xff,
  0xff, 0xff, 0xff, 0xff, 0xff, 0xff, 0xff, 0xff, 0xff, 0xff, 0xff, 0xff, 0xff, 0xff, 0xff, 0xff,
  0xff, 0xff, 0xff, 0xff, 0xff, 0xff, 0xff, 0xff, 0xff, 0xff, 0xff, 0xff, 0xff, 0xff, 0xff, 0xff,
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  0xff, 0xff, 0xff, 0xff, 0xff, 0xff, 0xff, 0xff, 0xff, 0xff, 0xff, 0xff, 0xff, 0xff, 0xff, 0xff
};


// 'succes21', 128x32px
const unsigned char PROGMEM bitmap_succes[] = {
  0xff, 0xff, 0xff, 0xff, 0xff, 0xff, 0xff, 0xff, 0xff, 0xff, 0xff, 0xf8, 0x3f, 0xff, 0xff, 0xff,
  0xff, 0xff, 0xff, 0xff, 0xff, 0xff, 0xff, 0xff, 0xff, 0xff, 0xfe, 0x00, 0x7f, 0xff, 0xff, 0xff,
  0xff, 0xff, 0xff, 0xff, 0xff, 0xff, 0xfc, 0x00, 0x00, 0xff, 0xf8, 0x01, 0xff, 0xff, 0xff, 0xff,
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  0xff, 0xff, 0xff, 0xff, 0xff, 0xff, 0xff, 0xff, 0xff, 0xff, 0xff, 0xff, 0xff, 0xff, 0xff, 0xff
};



/* ---------------------------------------------------------------------------------------------------- */



/* ---------------------------------------------------------------------------------------------------- */
// Define Firebase Data object
FirebaseData fbdo;
FirebaseAuth auth;
FirebaseConfig config;
WiFiManager wm;


//user created variable
unsigned long sendDataPrevMillis = 0;
String sValue;
int val;


int speaker = D3;
int pus_btn = D4;
int motor = D6;
int prev_btn_state = HIGH;
int curr_btn_state;
/* ---------------------------------------------------------------------------------------------------- */


void setup() {
  pinMode(LED_BUILTIN, OUTPUT);
  pinMode(speaker, OUTPUT);
  pinMode(motor,OUTPUT);
  pinMode(pus_btn, INPUT_PULLUP);

  digitalWrite(LED_BUILTIN, LOW);

  Serial.begin(115200);




  //display begins
  connectDisplay();
  initDisplay();
  track1();
  track1();
  track1();
  track1();
  track1();
  track1();
  wifiConnecting();

  if (digitalRead(pus_btn) == LOW) {
    wm.resetSettings();
    ESP.restart();
  }


  /* WiFi manager function */
  setupWiFiManager();

  //if wifi is connected the print wifi is connected
  wifiConnected();

  /* Assign the api key (required) */
  config.api_key = API_KEY;

  /* Assign the user sign in credentials */
  auth.user.email = USER_EMAIL;
  auth.user.password = USER_PASSWORD;

  /* Assign the RTDB URL (required) */
  config.database_url = DATABASE_URL;

  // Since v4.4.x, BearSSL engine was used, the SSL buffer need to be set.
  // Large data transmission may require larger RX buffer, otherwise connection issue or data read time out can be occurred.
  fbdo.setBSSLBufferSize(4096 /* Rx buffer size in bytes from 512 - 16384 */, 1024 /* Tx buffer size in bytes from 512 - 16384 */);

  // Limit the size of response payload to be collected in FirebaseData
  fbdo.setResponseSize(2048);

  Firebase.begin(&config, &auth);

  Firebase.setDoubleDigits(5);

  config.timeout.serverResponse = 10 * 1000;
}

void loop() {
  curr_btn_state = digitalRead(pus_btn);

  /* if wifi is disconnected by any mean try to reconnect by restarting the esp. */
  while (WiFi.status() != WL_CONNECTED) {
    Serial.println("wifi disconnected,  connecting..");
    Serial.print(".");
    ESP.restart();
    delay(500);
  }



  if ((prev_btn_state == HIGH) && (curr_btn_state == LOW)) {
    wm.resetSettings();
    ESP.restart();
  }
  prev_btn_state = curr_btn_state;


  if (Firebase.ready() && (millis() - sendDataPrevMillis > 1000 || sendDataPrevMillis == 0)) {
    sendDataPrevMillis = millis();

    if (Firebase.RTDB.getString(&fbdo, "/vlue")) {
      if (fbdo.dataType() == "string") {
        sValue = fbdo.to<String>();
        val = sValue.toInt();
        Serial.println(val);


        if (val != 0) {
          if (val < 0) quickDispence(val);
          else scrlDispence(val);

          Serial.println(" medecine despenses successfullyy value setting to zero");
          Firebase.RTDB.setString(&fbdo, "/vlue", "0");
          Serial.println("the value is set to zero");
        }
      }
    } else {
      Serial.println(fbdo.errorReason().c_str());
    }
  }
}


void setupWiFiManager() {
  track3();
  WiFi.mode(WIFI_STA);
  // wm.resetSettings();


  WiFi.forceSleepWake();
  WiFi.setSleepMode(WIFI_NONE_SLEEP);


  wm.setConnectTimeout(180);
  wm.setConnectRetries(100);
  if (wm.getWiFiIsSaved()) wm.setEnableConfigPortal(false);

  bool res;
  res = wm.autoConnect("AutoConnectAP");  // anonymous ap

  if (!res) {
    Serial.println("Failed to connect");
    ESP.restart();
  } else {
    //if wifi is  connected
    Serial.println("connected... :)");
    track2();
  }
}


void dd(int quan) {
  track3();
  track3();
  int x = quan / 20;
  int error = x * 2;
  quan -= error;
  int to_time = (quan * 100 /* *1666 */);
  /*digitalWrite(po,HIGH);
      digitalWrite(ne,LOW);
      delay(to_time);
      digitalWrite(po,LOW);*/

  digitalWrite(motor, HIGH);
  delay(to_time);
  digitalWrite(motor, LOW);
}

void quickDispence(int a) {
  if (a == -1) {
    formatMsg(50, 2);
    dd(50);
    Serial.println("quick despence 50ml");
  } else if (a == -2) {
    formatMsg(75, 2);
    dd(75);
    Serial.println("quick despence 75ml");
  } else if (a == -3) {
    formatMsg(100, 2);
    dd(100);
    Serial.println("quick despence 100ml");
  }
  dispense_successful();
}


void scrlDispence(int a) {
  formatMsg(a, 1);
  dd(a);
  dispense_successful();
  Serial.print("dispensing ");
  Serial.print(a);
  Serial.println("ml via scroll method in normal speed");
}


/* ---------------------------------------------------------------------------------------------------- */

void connectDisplay() {
  // SSD1306_SWITCHCAPVCC = generate display voltage from 3.3V internally
  if (!display.begin(SSD1306_SWITCHCAPVCC, SCREEN_ADDRESS)) {
    Serial.println(F("SSD1306 allocation failed"));
    for (;;)
      ;  // Don't proceed, loop forever
  }
  // Clear the buffer
  display.clearDisplay();
}

void initDisplay() {
  display.clearDisplay();
  display.drawBitmap(0, 0, init_logo, 128, 64, WHITE);
  display.display();
  delay(2000);
}

void wifiConnecting() {
  displayMessage("Connect AutoConnectAP for further setup.", 1, 0, 0);
  delay(6000);

  //showing bitmap and then scrool it
  display.clearDisplay();
  display.drawBitmap(0, 0, wifi_logo, 128, 64, WHITE);
  display.display();
  display.startscrollright(0x00, 0x0F);
}

void wifiConnected() {
  display.clearDisplay();
  display.stopscroll();

  displayMessage("Connected", 2, 15, 0);
  delay(2000);

  displayMessage("Ready to dispence...", 1, 0, 10);
}

void displayMessage(const char* message, int textSize, int x, int y) {
  display.clearDisplay();
  display.setTextSize(textSize);  // Set text size based on the argument
  display.setTextColor(SSD1306_WHITE);
  display.setCursor(x, y);
  display.println(message);  // Display the message based on the argument
  display.display();
}

void formatMsg(int vol, int method) {
  //1:scrool

  display.clearDisplay();

  display.setTextSize(2);  // Set text size based on the argument
  display.setTextColor(SSD1306_WHITE);
  display.setCursor(32, 0);

  display.println((String(vol) + "ml").c_str());

  display.setTextColor(SSD1306_WHITE);
  display.setTextSize(1);
  String msg = "  dispensing via";
  if (method == 1) {
    msg += "\n  SCROOL";
  } else {
    msg += "\n  QUICK";
  }
  msg += " method...";
  display.println(msg.c_str());
  display.display();
}

void dispense_successful() {
  display.clearDisplay();
  display.drawBitmap(0, 0, bitmap_succes, 128, 64, WHITE);
  display.display();
  track4();
  displayMessage("Ready to dispence...", 1, 0, 10);
}

void playTone(int pin, int duration, int after_duration) {
  digitalWrite(pin, HIGH);
  delay(duration);
  digitalWrite(pin, LOW);
  delay(after_duration);
}


void track1() {
  playTone(speaker, 10, 5);
  playTone(speaker, 20, 15);
  playTone(speaker, 20, 15);
  playTone(speaker, 10, 5);
}

void track2() {
  playTone(speaker, 20, 100);
  playTone(speaker, 40, 10);
  playTone(speaker, 40, 10);
  playTone(speaker, 20, 100);
}

void track3() {
  playTone(speaker, 30, 10);
  playTone(speaker, 10, 100);
  playTone(speaker, 30, 10);
}

void track4() {
  playTone(speaker, 1000, 100);
  playTone(speaker, 5, 5);
  playTone(speaker, 30, 50);
  playTone(speaker, 20, 20);
  playTone(speaker, 20, 20);
}
